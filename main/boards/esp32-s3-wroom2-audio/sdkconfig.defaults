## main/boards/esp32-s3-wroom2-audio/sdkconfig.defaults
```kconfig
CONFIG_BOARD_TYPE_ESP32_S3_WROOM2_AUDIO=y
CONFIG_ESPTOOLPY_FLASHSIZE_8MB=y
CONFIG_PARTITION_TABLE_CUSTOM_FILENAME="partitions/v2/8m.csv"
CONFIG_LANGUAGE_EN_US=y
CONFIG_OTA_URL="http://<your-ota-server>/xiaozhi/ota/"
CONFIG_ESP_CONSOLE_USB_SERIAL_JTAG=y
CONFIG_SPIRAM_MODE_OCT=y
```

## main/boards/lilygo-t-display-s3/sdkconfig.defaults
```kconfig
CONFIG_BOARD_TYPE_LILYGO_T_DISPLAY_S3=y
CONFIG_ESPTOOLPY_FLASHSIZE_16MB=y
CONFIG_PARTITION_TABLE_CUSTOM_FILENAME="partitions/v2/16m.csv"
CONFIG_LANGUAGE_EN_US=y
CONFIG_OTA_URL="http://192.168.1.39:8003/xiaozhi/ota/"
```

## main/boards/waveshare/esp32-s3-touch-amoled-1.8/sdkconfig.defaults
```kconfig
CONFIG_BOARD_TYPE_WAVESHARE_ESP32_S3_TOUCH_AMOLED_1_8=y
CONFIG_USE_WECHAT_MESSAGE_STYLE=y
CONFIG_OTA_URL="http://192.168.1.39:8003/xiaozhi/ota/"
CONFIG_LANGUAGE_EN_US=y
CONFIG_ESP_CONSOLE_USB_SERIAL_JTAG=y
```

## main/boards/xiao-esp32-c3/sdkconfig.defaults
```kconfig
CONFIG_BOARD_TYPE_XIAO_ESP32C3=y
CONFIG_ESPTOOLPY_FLASHSIZE_4MB=y
CONFIG_LANGUAGE_EN_US=y
CONFIG_ESP_CONSOLE_USB_SERIAL_JTAG=y
CONFIG_OTA_URL="http://192.168.1.39:8003/xiaozhi/ota/"
```

## main/boards/xiao-esp32-c6-eyes/sdkconfig.defaults
```kconfig
CONFIG_BOARD_TYPE_XIAO_ESP32C6_EYES=y
CONFIG_ESPTOOLPY_FLASHSIZE_4MB=y
CONFIG_PARTITION_TABLE_CUSTOM_FILENAME="partitions/v2/4m.csv"
CONFIG_LANGUAGE_EN_US=y
CONFIG_ESP_CONSOLE_USB_SERIAL_JTAG=y
CONFIG_OTA_URL="http://<your-ota-server>/xiaozhi/ota/"
```

## main/boards/xiao-esp32-c6/sdkconfig.defaults
```kconfig
CONFIG_BOARD_TYPE_XIAO_ESP32C6=y
CONFIG_ESPTOOLPY_FLASHSIZE_4MB=y
CONFIG_LANGUAGE_EN_US=y
CONFIG_ESP_CONSOLE_USB_SERIAL_JTAG=y
# Update this to the laptop's IP on the event WiFi before building
CONFIG_OTA_URL="http://192.168.1.100:8003/xiaozhi/ota/"
```

## main/boards/xiao-esp32-s3-sense/sdkconfig.defaults
```kconfig
CONFIG_BOARD_TYPE_XIAO_ESP32S3_SENSE=y
CONFIG_ESPTOOLPY_FLASHSIZE_8MB=y
CONFIG_PARTITION_TABLE_CUSTOM_FILENAME="partitions/v2/8m.csv"
CONFIG_LANGUAGE_EN_US=y
CONFIG_ESP_CONSOLE_USB_SERIAL_JTAG=y
CONFIG_OTA_URL="http://192.168.5.6:8003/xiaozhi/ota/"
```
